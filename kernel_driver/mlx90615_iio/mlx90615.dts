/dts-v1/;
/plugin/;
/ {
    compatible = "brcm,bcm2708";
    fragment@0 {
        target = <&i2c2>;
        __overlay__ {
            #address-cells = <1>;
            #size-cells = <0>;
            status = "okay";
            mlx90615@5b {
                compatible = "mlx90615";
                reg = <0x5b>;

            };
        };
    };
};
