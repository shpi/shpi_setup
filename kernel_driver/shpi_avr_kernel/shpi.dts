/dts-v1/;
/plugin/;
/ {
    compatible = "brcm,bcm2708";

    fragment@0 {
        target = <&i2c2>;

        __overlay__ {
            #address-cells = <1>;
            #size-cells = <0>;
            status = "okay";

	    shpi@2A {
            compatible = "shpi";
            reg = <0x2A>;
            };

    };

    };


};

